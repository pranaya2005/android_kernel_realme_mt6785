## drivers/input/fingerprint/Kconfig
```kconfig
#
#Fingerprint
#
menu "Fingerprint support"
	depends on INPUT

if MTK_FINGERPRINT_SELECT = "SUNWAVE_TEE"
config SUNWAVE_TEE_FINGERPRINT
     bool "SUNWAVE_FP_TEE Fingerprint"
     default n
     ---help---
     SUNWAVE_FP_TEE fingerprint.
endif


config MTK_FINGERPRINT_SUPPORT
	bool "Mediatek Fingerprint"
	default n
	help
	  Fingerprint mtk driver enable/disable
	  in the kernel.Say Y here if you want to
	  use mediatek fingerprint driver,fingerprint
	  driver will support fingerprint function

if MTK_FINGERPRINT_SUPPORT
config MTK_FINGERPRINT_SELECT
	string "sensor type"
	default "GF318M"

if MTK_FINGERPRINT_SELECT = "FPC1028"
config FPC_REE_FINGERPRINT
    bool "FPC ree Fingerprint"
    default y
    help
    FPC ree fingerprint FPC's 102x device.
endif

if MTK_FINGERPRINT_SELECT = "FPC1145"
config FPC_FINGERPRINT
	bool "FPC Fingerprint"
	default y
	help
	  FPC fingerprint FPC's 102x/104x device.
endif

if MTK_FINGERPRINT_SELECT = "GF318M" ||  MTK_FINGERPRINT_SELECT = "GF5216"
config GOODIX_FINGERPRINT
	bool "Goodix Fingerprint"
	default y
	help
	  Goodix Fingerprint chip GF316M/GF318M/
	  GF3118M/GF518M/GF5118M/GF516M/GF816M/
	  GF3208/GF3206/GF3266/GF3288/GF5206/
	  GF5216/GF5208 TEE driver
endif

config GOODIX_SENSOR_TYPE
	string "SENSOR_TYPE"
	default "GF5216"
	help
	  Must input sensor type, or default is
	  GF316M GF318M GF3118M GF518M GF5118M
	  GF516M GF816M GF3208 GF3206 GF3266
	  GF3288 GF5206 GF5216 GF5208
endif
if MTK_FINGERPRINT_SELECT = "MICROARRAY"
config FINGERPRINT_MICROARRAY_FP
	bool "MICROARRAY Fingerprint"
	default y
	---help---
	Microarray fingerprint.
endif
if MTK_FINGERPRINT_SELECT = "CDFINGER"
config FINGERPRINT_CDFINGER_FP
	bool "CDFINGER Fingerprint"
	default y
	---help---
	Cdfinger fingerprint.
endif
if MTK_FINGERPRINT_SELECT = "CDFINGER_REE"
config FINGERPRINT_CDFINGER_FP_REE
	bool "CDFINGER Fingerprint Ree"
	default y
	---help---
	Cdfinger fingerprint ree.
endif
if MTK_FINGERPRINT_SELECT = "BLESTECH"
config FINGERPRINT_BLESTECH
	bool "BLESTECH Fingerprint"
	default y
	---help---
	BLESTECH fingerprint.
endif
if MTK_FINGERPRINT_SELECT = "FPSENSOR_JC_TEE"
config FINGERPRINT_FPSENSOR_JC_TEE
     bool "FPSENSOR_JC_TEE Fingerprint"
     default y
     ---help---
     FPSENSOR_JC_TEE fingerprint.
endif
if MTK_FINGERPRINT_SELECT = "FPSENSOR_JC_FPC1028_TEE"
config FINGERPRINT_FPSENSOR_JC_TEE
     bool "FPSENSOR_JC_TEE Fingerprint"
     default y
     ---help---
     FPSENSOR_JC_TEE fingerprint.
config FPC_REE_FINGERPRINT
	bool "FPC ree Fingerprint"
	default y
	---help---
	FPC ree fingerprint FPC's 102x/104x device.
endif
if MTK_FINGERPRINT_SELECT = "FPC1028_SUNWAVE_TEE"
config SUNWAVE_TEE_FINGERPRINT
     bool "SUNWAVE_FP_TEE Fingerprint"
     default n
     ---help---
     SUNWAVE_FP_TEE fingerprint.
config FPC_REE_FINGERPRINT
	bool "FPC ree Fingerprint"
	default y
	---help---
	FPC ree fingerprint FPC's 102x/104x device.
endif
if MTK_FINGERPRINT_SELECT = "BLESTECH_MICROARRAY_TEE"
config FINGERPRINT_BLESTECH
	bool "BLESTECH Fingerprint"
	default y
	---help---
	BLESTECH fingerprint.
config FINGERPRINT_MICROARRAY_FP
	bool "MICROARRAY Fingerprint"
	default y
	---help---
	Microarray fingerprint.
endif

endmenu
```

## drivers/misc/mediatek/saga_memory/Kconfig
```kconfig
config SAGA_MEMORY
	bool "SAGA_MEMORY"
	default n
	help
	  This option enables saga memory apk,
	  if yes, it means this platform supports saga memory app,
	  if no, it means this platform supports saga memory app.
	  The option default disabled.
```
